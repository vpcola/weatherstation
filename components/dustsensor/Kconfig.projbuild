## components/dustsensor/Kconfig.projbuild
```kconfig
menu "Dust Sensor Configuration"


config DUSTSENSOR_LED_PIN 
    int "Dust sensor led pin"
    range 0 34
    default 26
    help
        "The dust sensor LED pin"

choice DUSTSENSOR_ADC_UNIT 
	prompt "Sets the ADC unit to use (ADC1 or ADC2). For the dust sensor, we only use channel 0"

	config DUSTSENSOR_USE_ADC1
		bool "ADC1"

	config DUSTSENSOR_USE_ADC2
		bool "ADC2"

endchoice

endmenu
```

## components/ili9341/Kconfig
```kconfig
menu "ILI9341 Settings"

config ILI9341_MISO
	int "ILI9341 MISO Pin"
	default 19
	range 0 39

config ILI9341_MOSI
	int "ILI9341 MOSI Pin"
	default 23
	range 0 39

config ILI9341_SCK
	int "ILI9341 SCK Pin"
	default 18
	range 0 39

config ILI9341_CS
	int "ILI9341 CS Pin"
	default 26
	range 0 39

config ILI9341_DC
	int "ILI9341 DC Pin"
	default 27
	range 0 39

config ILI9341_BCKL
	int "ILI9341 Backlight Pin"
	default GPIO_NUM_NC
	range -1 39

config ILI9341_RESET
	int "ILI9341 Reset Pin"
	default 14
	range 0 39

endmenu
```

## components/lvgl/Kconfig
```kconfig
menu "LVGL Driver Settings"
config LVGL_ENABLE
default y
help 
	"Select this one to enable LVGL component"

menu "ILI9341 Settings"
depends on LVGL_ENABLE

config ILI9341_CS
	int "ILI9341 CS Pin"
	default 26
	range 0 39

config ILI9341_DC
	int "ILI9341 DC Pin"
	default 27
	range 0 39

config ILI9341_BCKL
	int "ILI9341 Backlight Pin"
	default -1
	range -1 39

config ILI9341_RESET
	int "ILI9341 Reset Pin"
	default 14
	range 0 39

endmenu

menu "XPT2046 Settings"
depends on LVGL_ENABLE

config XPT2046_CS
	int "XPT2046 CS Pin"
	default 12
	range 0 39

config XPT2046_IRQ
	int "XPT2046 IRQ Pin"
	default 13 
	range 0 39

endmenu

endmenu
```

## components/xpt2046/Kconfig
```kconfig
menu "XPT2046 Settings"

config XPT2046_MISO
	int "XPT2046 MISO Pin"
	default 19
	range 0 39

config XPT2046_MOSI
	int "XPT2046 MOSI Pin"
	default 23
	range 0 39

config XPT2046_SCK
	int "XPT2046 SCK Pin"
	default 18
	range 0 39

config XPT2046_CS
	int "XPT2046 CS Pin"
	default 12
	range 0 39

config XPT2046_IRQ
	int "XPT2046 IRQ Pin"
	default 13 
	range 0 39

endmenu
```

## main/Kconfig.projbuild
```kconfig
menu "IOTCebu Configuration"

menu "I2C Master"

config I2C_MASTER_SCL
    int "SCL GPIO Num"
    default 22 
    help
        GPIO number for I2C Master clock line.

config I2C_MASTER_SDA
    int "SDA GPIO Num"
    default 21
    help
        GPIO number for I2C Master data line.

config I2C_MASTER_PORT_NUM
    int "Port Number"
    default 0
    help
        Port number for I2C Master device.

config I2C_MASTER_FREQUENCY
    int "Master Frequency"
    default 100000
    help
        I2C Speed of Master device.
endmenu

menu "Plantower PMS5003"

choice DUSTSENSOR_UART_PORT
    prompt "UART Port for Plantower PMS5003"
    default DUSTSENSOR_UART_PORT_1
    help
        UART1 and UART2 are available, UART0 is used for debugging.


    config DUSTSENSOR_UART_PORT_1
        bool "UART1"

    config DUSTSENSOR_UART_PORT_2
        bool "UART2"
endchoice

config DUSTSENSOR_UART_RX_PIN 
    int "UART GPIO number"
    range 0 34
    default 4 
    help
        GPIO number for the UART RX pin.

endmenu

menu "RFM95W Lora Module"

config RFM95W_SCLK
    int "SPI SCLK Pin"
    range 0 34
    default 18
    help
        "The SPI SCLK pin connected to the Lora RFM95W module"

config RFM95W_MISO
    int "SPI MISO Pin"
    range 0 34
    default 19
    help
        "The SPI MISO pin connected to the Lora RFM95W module"

config RFM95W_MOSI
    int "SPI MOSI Pin"
    range 0 34
    default 23
    help 
        "The SPI MOSI pin connected to the Lora RFM95W module"

config RFM95W_NSS
    int "SPI Chip Select Pin"
    range 0 34
    default 5
    help
        "The chip select pin connected to the Lora RFM95W module"

config RFM95W_RST
    int "Lora RFM95W reset pin"
    range 0 34
    default 25
    help 
        "The reset pin connected to the Lora RFM95W module"

config RFM95W_DIO0
    int "Lora RFM95W DIO0 pin"
    range 0 34
    default 26
    help
        "The DIO0 pin of the RFM95W module"

config RFM95W_DIO1
    int "Lora RFM95W DIO1 pin"
    range 0 34
    default 34
    help
        "The DIO1 pin of the RFM95W module"

endmenu

menu "TTN Configuration"

config TTN_DEV_EUI
    string "TTN Dev EUI"
    help
        "Copy the device EUI in the TTN device overview page."

config TTN_APP_EUI
    string "TTN APP EUI"
    help
        "The Application EUI as shown on the TTN console when creating the app"

config TTN_APP_KEY
    string "TTN APP Key"
    help 
        "The TTN app key as shown on the TTN console when creating the app"

endmenu

config ENABLE_TOUCH_WAKEUP
    bool "Enable touch wake up"
    default y
    help
        This option enables wake up from deep sleep using touch pads
        TOUCH8 and TOUCH9, which correspond to GPIO33 and GPIO32.

config WAKEUP_INTERVAL
    int "Wakeup interval in seconds"
    default 60
    help
        This is the interval time for timed wakeup in seconds.

config WAKEUP_LED
    int "GPIO Pin connected to Wakeup LED"
    range 0 34
    default 15
    help 
        This option sets the wakeup led pin that is connected to the
        wakeup led.

endmenu
```
